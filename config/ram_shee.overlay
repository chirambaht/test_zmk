#include <dt-bindings/zmk/matrix_transform.h>

/ {
    chosen {
        zmk,kscan = &kscan0;
    };

    kscan0: kscan_0 {
        compatible = "zmk,kscan-gpio-matrix";
        diode-direction = "col2row";
        wakeup-source;

        col-gpios
            = <&pico_header 19 GPIO_ACTIVE_HIGH>
            , <&pico_header 20 GPIO_ACTIVE_HIGH>
            , <&pico_header 21 GPIO_ACTIVE_HIGH>
            ;

        row-gpios
            = <&pico_header 10 (GPIO_ACTIVE_HIGH | GPIO_PULL_DOWN)>
            , <&pico_header 11 (GPIO_ACTIVE_HIGH | GPIO_PULL_DOWN)>
            ;
    };
};